## conf/layer.conf
```bitbake
# We have a conf and classes directory, append to BBPATH
BBPATH .= ":${LAYERDIR}"

# We have a recipes directory, add to BBFILES
BBFILES += " \
    ${LAYERDIR}/recipes-*/*/*.bb       \
    ${LAYERDIR}/recipes-*/*/*.bbappend \
"

BBFILE_COLLECTIONS += "meta-castboard-autorun"
BBFILE_PATTERN_meta-castboard-autorun := "^${LAYERDIR}/"

# Setting this variable allows you to prioritize a layer against other
# layers that contain the same recipe. A larger value for the 
# BBFILE_PRIORITY variable results in a higher precedence. 
BBFILE_PRIORITY_meta-castboard-autorun = "7"

LAYERSERIES_COMPAT_meta-castboard-autorun = "zeus dunfell honister hardknott gatesgarth"
```
